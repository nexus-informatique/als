## conf/layer.conf
```bitbake
# We have a conf and classes directory, append to BBPATH
BBPATH .= ":${LAYERDIR}"

# We have a recipes directory, add to BBFILES
BBFILES += "${LAYERDIR}/recipes*/*/*.bb ${LAYERDIR}/recipes*/*/*.bbappend"

BBFILE_COLLECTIONS += "meta-nexusinfo"
BBFILE_PATTERN_meta-nexusinfo := "^${LAYERDIR}/"
BFILE_PRIORITY_meta-nexusinfo = "12"
```
